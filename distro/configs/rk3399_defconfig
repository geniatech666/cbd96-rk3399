## distro/package/gst-plugins-bad/Config.in
```kconfig
config BR2_PACKAGE_GST_PLUGINS_BAD
	bool "gst-plugins-bad"
	depends on BR2_PACKAGE_GSTREAMER
	help
	  "gstreamer bad plugin"
```

## distro/package/gst-plugins-base/Config.in
```kconfig
config BR2_PACKAGE_GST_PLUGINS_BASE
	bool "gst-plugins-base"
	depends on BR2_PACKAGE_GSTREAMER
	help
	  "gstreamer base plugin"
```

## distro/package/gst-plugins-good/Config.in
```kconfig
config BR2_PACKAGE_GST_PLUGINS_GOOD
	bool "gst-plugins-good"
	depends on BR2_PACKAGE_GSTREAMER
	help
	  "gstreamer good plugin"
```

## distro/package/gst-plugins-ugly/Config.in
```kconfig
config BR2_PACKAGE_GST_PLUGINS_UGLY
	bool "gst-plugins-ugly"
	depends on BR2_PACKAGE_GSTREAMER
	help
	  "gstreamer ugly plugin"
```

## distro/package/libmali/Config.in
```kconfig
config BR2_PACKAGE_LIBMALI
	bool "libmali"
	depends on BR2_PACKAGE_WESTON
	help
	  "mali user space library"
```
